## src/safety_island_tracing/Kconfig.island_trace
```kconfig
# The island's trace window (phase8-W17). Sourced by the Kconfig of each
# Zephyr entry (src/*_entry/Kconfig); include/island_trace.h is the code and
# docs/tracing.md section 8 the design and the measurements.

config ISLAND_TRACE_WINDOW
	bool "Island trace window: pre-trigger ring, trigger, record policy"
	depends on TRACING_CTF && TRACING_BACKEND_RAM
	help
	  Off, the island's markers enter the RAM trace buffer from boot, every
	  one (phase 7). On, only the provenance does; markers and heartbeats
	  go to a small ring until the contract's detector path first runs
	  after the HPC has once reported "autonomous available" (the trigger),
	  and a per-marker record policy generated from the contract drops the
	  repeats of timer spins and unchanged publishes. The buffer then holds
	  an act, not the first seconds after boot.

if ISLAND_TRACE_WINDOW

config ISLAND_TRACE_PRE_MS
	int "Pre-trigger history kept at the trigger (ms)"
	range 0 2000
	default 1500
	help
	  Ring records older than this at the trigger are not written. At most
	  2000: the decoder unwraps u32 ns stamps by signed difference, which
	  holds for steps under 2.1 s, and the flushed history precedes the
	  trigger record. The encore needs the last availability sample before
	  the silence, which is 500 ms plus a tick before the trigger.

config ISLAND_TRACE_PRE_BYTES
	int "Pre-trigger ring (bytes, two halves)"
	range 64 16384
	default 2048
	help
	  The history held is between one half and the whole ring, so one half
	  must cover ISLAND_TRACE_PRE_MS at the pre-trigger record rate.

config ISLAND_TRACE_SPIN_KEEP
	int "Keep one timer-path tick in N whose state did not change"
	range 1 1000
	default 10
	help
	  1 keeps every tick (execution-time samples of every spin).

endif

config ISLAND_DEBUG_OVERRUN
	bool "Debug hook: one commanded busy-wait in the handler's tick"
	help
	  phase9-W4. Compiles in `island_debug_overrun_ms`, a volatile u32 the
	  handler reads on every tick in RUN. It is 0 from boot and the hook
	  does nothing while it is 0; a debugger writing N > 0 into it (over
	  SWD: tools/timeline/violations.py overrun N) makes the NEXT RUN tick
	  busy-wait N ms after its publishes, once, and clears it. A tick that
	  long trips the contract's max-latency-runtime monitors on the
	  handler's publishers (hazard_lights_cmd 100 ms, mrm_state and
	  takeover_request_state 206 ms) and, because the one executor is
	  blocked, the spin's release-jitter and the timers' overrun rules.
	  It is the board's end-to-end test of the violation channel
	  (docs/takeover-trace.md section 12). No link entity, no parameter
	  service, no contract change: only a debugger can command it.
```
