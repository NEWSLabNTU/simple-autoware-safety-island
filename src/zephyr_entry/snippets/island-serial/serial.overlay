/* Console off the wired UART. Required by serial.conf — see its header. */
/* Console moves to lpuart0, which has no cable on this board, so log output
 * goes nowhere instead of corrupting zenoh's COBS frames. lpuart2 (DCD-LZ P6,
 * /dev/ttyUSB0) is the one wired UART and belongs to zenoh. */
/ {
	chosen {
		zephyr,console = &lpuart0;
		zephyr,shell-uart = &lpuart0;
	};
};
&lpuart0 { current-speed = <115200>; status = "okay"; };
/* 921600: the rate the zenoh locator in serial.conf configures at session open
 * (see its header); kept equal so the UART never runs at a second rate. */
&lpuart2 { current-speed = <921600>; status = "okay"; };
