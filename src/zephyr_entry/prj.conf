## CMakeLists.txt
```
# Zephyr entry for the BOARD (MR-CANHUBK344, zenoh): all four ported Autoware
# nodes in one bootable image. Shape mirrors nano-ros examples/workspaces/
# mixed/src/zephyr_entry (C++-only variant -- no Rust node).
#
#   just board-build     (west build -b mr_canhubk3/s32k344 -S nros-zenoh ...)
#
# The native_sim / Cyclone image the demo runs is src/native_sim_entry, a
# SEPARATE entry package since the nano-ros bump of 2026-09-21: nano-ros
# resolves an image from its ENTRY PACKAGE (`nros image-facts --for-entry`)
# and refuses a west build whose Kconfig RMW disagrees with the image's `rmw`
# (cmake/NanoRosImageAgreement.cmake), so one entry cannot honestly be both a
# zenoh board image and a Cyclone native_sim image. This package used to be
# both, built two ways. Board-only policy -- the TCM relocation below,
# boards/, snippets/ -- stays here.

cmake_minimum_required(VERSION 3.20.0)

# Workspace-local msg pkgs resolve through the auto-emitted Find-stubs — the
# search path must be visible before nano_ros's stub machinery loads.
set(NROS_INTERFACE_SEARCH_PATH "${CMAKE_CURRENT_SOURCE_DIR}/..")

# Transport snippets live in this directory (snippets/island-serial,
# snippets/island-ethernet). Zephyr resolves SNIPPET_ROOT relative to the
# application but does NOT seed it with the application itself, so without this
# line `-S island-serial` fails with "unknown snippet" and the caller has to
# remember -DSNIPPET_ROOT on every build. Must precede find_package(Zephyr):
# snippets are processed during its boilerplate.
list(APPEND SNIPPET_ROOT ${CMAKE_CURRENT_SOURCE_DIR})

find_package(Zephyr REQUIRED HINTS $ENV{ZEPHYR_BASE})
project(safety_island_zephyr_entry)

# RFC-0048: on Zephyr find_package(nano_ros) supplies the verbs + entry
# machinery; the nano-ros west module already provides the runtime.
#
# PIN IT TO THE SUBMODULE. Unpinned, find_package() is free to resolve
# nano_ros from anywhere on CMAKE_PREFIX_PATH -- on a machine that also has a
# standalone nano-ros checkout it silently picks that one up, and the build
# then uses ANOTHER tree's cmake verbs and codegen against THIS tree's sources.
# It fails far away from the cause: caps in nros-codegen.toml stop being
# applied, every type reads as unbounded, and the static_asserts fire on
# messages nobody touched. Diagnosed the long way once (seven separate
# detours); the tell is `nano_ros_DIR` in CMakeCache.txt naming a path outside
# this repo. An explicit -Dnano_ros_DIR= still wins, so this only supplies the
# default nobody should have to remember.
if(NOT DEFINED nano_ros_DIR)
    set(nano_ros_DIR "${CMAKE_CURRENT_SOURCE_DIR}/../../third-party/nano-ros"
        CACHE PATH "nano-ros checkout backing this island (default: the submodule)")
endif()
find_package(nano_ros REQUIRED)
get_filename_component(_nros_resolved "${nano_ros_DIR}" REALPATH)
get_filename_component(_nros_expected "${CMAKE_CURRENT_SOURCE_DIR}/../../third-party/nano-ros" REALPATH)
if(NOT _nros_resolved STREQUAL _nros_expected)
    message(WARNING
        "nano_ros resolved to ${_nros_resolved}, NOT this repo's submodule at "
        "${_nros_expected}. That is supported, but say so deliberately -- an "
        "ACCIDENTAL one produces unbounded-type errors in untouched messages.")
endif()

if(NOT COMMAND nano_ros_workspace_pkg_guard)
    function(nano_ros_workspace_pkg_guard)
    endfunction()
endif()

# Platform thread/task stack pools: NOT set here. Kconfig owns them.
#
# This block used to call zephyr_compile_definitions() with
# NROS_ZEPHYR_MAX_SCHED_TASKS=1, NROS_ZEPHYR_SCHED_TASK_STACK_SIZE=4096 and
# NROS_ZEPHYR_MAX_THREADS=4, and the comment claimed the entry kept "one
# minimal slot". It did not. nano-ros emits the same three tokens from Kconfig
# (third-party/nano-ros/zephyr/CMakeLists.txt:97-108), so BOTH landed on every
# compile command and gcc warned three times per TU:
#
#   <command-line>: warning: "NROS_ZEPHYR_MAX_SCHED_TASKS" redefined
#
# CMake sorts and de-duplicates the -D list, so which copy survives was decided
# by the lexicographic order of the whole token, not by call order. Measured in
# build-board/compile_commands.json, in this order:
#
#   -DNROS_ZEPHYR_MAX_THREADS=4      (here)      -DNROS_ZEPHYR_MAX_THREADS=5     (Kconfig, wins)
#   -DNROS_ZEPHYR_MAX_SCHED_TASKS=1        (here)      -DNROS_ZEPHYR_MAX_SCHED_TASKS=4       (Kconfig, wins)
#   -DNROS_ZEPHYR_SCHED_TASK_STACK_SIZE=16384 (Kconfig) -DNROS_ZEPHYR_SCHED_TASK_STACK_SIZE=4096 (here, wins)
#
# "16384" sorts before "4096", so the entry won exactly one of the three, by
# accident. The effective build was MAX_THREADS=5, MAX_TIERS=4,
# TIER_STACK_SIZE=4096, confirmed in build-board/zephyr/zephyr_pre0.map:
#
#   nros_thread_stacks    0xa000 = 5 x NROS_ZEPHYR_STACK_SIZE(8192)   LINKED
#   nros_sched_task_threads     0x440  = 4 x sizeof(struct k_thread)        discarded
#   the task stack array  0x4000 = 4 x 4096                           discarded
#
# Both task objects sit in the map's "Discarded input sections" list: this
# entry's system model declares no task and the generated entry contains no
# task spawn, so --gc-sections drops the pool whatever its size. That is why
# the redefinition was harmless HERE and cost 0 bytes -- not because the
# numbers agreed.
#
# So the definitions are deleted rather than reconciled. Both knobs have
# Kconfig rows with help text (nano-ros zephyr/Kconfig, NROS_ZEPHYR_TASK_SLOTS
# / NROS_ZEPHYR_MAX_SCHED_TASKS / NROS_ZEPHYR_SCHED_TASK_STACK_SIZE), and the board conf
# already sets CONFIG_NROS_ZEPHYR_TASK_SLOTS=5 with its reasoning. Set these
# from a .conf, next to the rest of this image's sizing; a value written here
# would only re-enter the same coin toss.

# Parameter pool sizing -- STALE SINCE nano-ros 1f3b88aec (phase-427 W4).
#
# This used to size an unknobbed pool (nano-ros issue 0316): `ComponentNode`
# embedded a `ParameterServer<NROS_COMPONENT_MAX_PARAMS, ...>` by value, so the
# default 256 scalar slots cost ~51 KiB of .bss PER NODE, and the three
# `add_compile_definitions` below were the only way to shrink it (the header
# guarded each with #ifndef; nothing in CMake/Kconfig/env fed them otherwise).
#
# `ComponentNode` is gone, and with it that embed. `NROS_COMPONENT_MAX_PARAMS`,
# `NROS_COMPONENT_MAX_SEQ_PARAMS` and `NROS_COMPONENT_SEQ_POOL_BYTES` are not
# read by any nano-ros header any more -- the three lines this comment used to
# introduce are inert now, which is why they are gone too. Parameters live in
# ONE store the EXECUTOR owns (shared across every node on it, so `ros2 param
# get` and a sibling node both see what one node declared), sized by the
# Rust-side `NROS_MAX_PARAMETERS` knob (crate default 32) -- on Zephyr that is
# `CONFIG_NROS_MAX_PARAMETERS` in prj.conf, `-1` (derive from the system
# contract's declared `params:`) by Kconfig default, falling to the crate
# default where the contract declares none. Sizing that pool for this entry's
# four nodes is unstarted; it is not a compile definition here any more.

# Interface union first (one superset FFI archive — nano-ros #253), then the
# node component libs the model names.
add_subdirectory("${CMAKE_CURRENT_SOURCE_DIR}/../island_interfaces" island_interfaces)
add_subdirectory("${CMAKE_CURRENT_SOURCE_DIR}/../autoware_mrm_emergency_stop_operator" autoware_mrm_emergency_stop_operator)
add_subdirectory("${CMAKE_CURRENT_SOURCE_DIR}/../autoware_mrm_comfortable_stop_operator" autoware_mrm_comfortable_stop_operator)
add_subdirectory("${CMAKE_CURRENT_SOURCE_DIR}/../autoware_mrm_handler" autoware_mrm_handler)

# phase8-W17: the component libraries are not Zephyr libraries, so nothing
# orders them after Zephyr's generated headers. With tracing on, every
# component includes <zephyr/kernel.h> (include/island_trace.h), which on 4.4
# includes the generated zephyr/heap_constants.h; a parallel build then
# compiled a component before that header existed ("zephyr/heap_constants.h:
# No such file or directory", the traced QEMU image, first build).
foreach(_island_lib mrm_emergency_stop_operator_lib mrm_comfortable_stop_operator_lib mrm_handler_lib)
    if(TARGET ${_island_lib} AND TARGET zephyr_generated_headers)
        add_dependencies(${_island_lib} zephyr_generated_headers)
    endif()
endforeach()

# Relocate the entry's .bss into DTCM. The S32K344 has 64 KiB ITCM + 128 KiB
# DTCM that this image otherwise leaves idle while SRAM runs near capacity. The
# app library's .bss is the executor storage (53,776 B at nano-ros 43fc1c2f7,
# phase9-C10) plus the per-node component buffers (10,008 B) -- all CPU-only, which is the constraint that
# matters: TCM is NOT reachable by the DMA masters, so the Ethernet descriptors
# and the net_pkt/net_buf pools must stay in SRAM. Do not extend this to the
# net stack.
#
# REQUIRES patches/zephyr/0001-gen_relocate_app-fix-source-to-object-matching.
# Stock Zephyr 4.4 cannot relocate a source generated into the build root: its
# source-to-object matcher assumes the object tree mirrors the source tree, and
# on no match it writes an EMPTY fragment, prints nothing and exits 0. Without
# that patch this line links fine and relocates nothing.
#
# Verify by the DTCM line of the region report, never by the build succeeding.
zephyr_code_relocate(LIBRARY app LOCATION DTCM_BSS)

# phase9-C2: the RAM tracing backend's buffer (`ram_tracing`, with its `pos`
# and `buffer_full`) goes to DTCM as well. It is written by the CPU only
# (tracing_backend_ram.c: a bounds check and a memcpy) and read over SWD,
# so the DMA constraint above does not apply. This takes the buffer out of
# SRAM, which runs near capacity, and lets it grow into DTCM's idle half:
# the board conf sizes it (CONFIG_RAM_TRACING_BUFFER_SIZE, docs/tracing.md
# section 8). A Zephyr-tree source matches without the patch above; verify by
# the DTCM line of the region report and `ram_tracing`'s address (0x2000xxxx).
if(CONFIG_CODE_DATA_RELOCATION AND CONFIG_TRACING_BACKEND_RAM)
    zephyr_code_relocate(FILES ${ZEPHYR_BASE}/subsys/tracing/tracing_backend_ram.c LOCATION DTCM_BSS)
endif()

# The serial link on DMA (CONFIG_NROS_ZENOH_SERIAL_UART_ASYNC, board conf):
# the eDMA writes the RX buffers and reads the TX ring, and the M7's D-cache
# sits in front of SRAM, so those buffers must be in DTCM. nano-ros's
# CONFIG_NROS_ZENOH_SERIAL_TCM puts them there (zenoh-pico
# src/link/transport/serial/uart_zephyr.c: code to ITCM, .bss to DTCM; nano-ros
# issue 2303, from 27d1c571da). Verify: `_z_serial_async_rx_buf`,
# `_z_serial_rx_storage` and `_z_serial_tx_storage` at 0x2000xxxx/0x2001xxxx (nm).

# phase9-C10: DTCM headroom. DTCM now holds the trace buffer (53,248 B) and
# the app library's .bss (the executor storage, 53,776 B, and the component
# buffers, 10,008 B), and since 2026-11-06 the serial link's rings and DMA
# buffers again (uart_zephyr.c, nano-ros SERIAL_TCM, about 15 KiB: 117,984 of 131,072 B).
# At phase9-C5 it stood at 130,408 of 131,072 B, and the region report is
# only read when something breaks. linker/dtcm-headroom.ld fails the link below 8 KiB free: room for
# one more component buffer the size of the largest (5,104 B) plus a store
# growth like C5's (+1,720 B), with change to spare. A change that needs more
# moves something out of DTCM, or lowers the guard on purpose, in the same
# commit.
if(CONFIG_CODE_DATA_RELOCATION)
    zephyr_linker_sources(SECTIONS ${CMAKE_CURRENT_SOURCE_DIR}/linker/dtcm-headroom.ld)
endif()

# ---------------------------------------------------------------------------
# ITCM: the safety application's own code.
#
# WHAT THIS BUYS. The I-cache is already on (CONFIG_ICACHE=y), so this is NOT a
# throughput win -- a hot loop already runs near zero-wait out of cache. What
# ITCM changes is DETERMINISM and cache pressure. The M7's I-cache is small
# against 421 KiB of text, so the MRM decision path competes for lines with the
# net stack, the shell and the Rust executor, and a decision that follows an
# idle period pays flash wait states on every miss. Code in ITCM is
# zero-wait-state ALWAYS, with no miss to jitter the response, and it stops
# occupying cache lines the rest of the image can then use. For a safety island
# the worst case is the number that matters, not the average.
#
# WHAT GOES HERE. The four MRM node bodies: 12,816 B measured, 19.6% of the
# region. NOT the Rust executor and NOT the net stack -- the net stack's buffers
# must stay DMA-reachable (see above; the same DMA constraint applies to ITCM).
#
# Be accurate about the granularity: LIBRARY moves the WHOLE library, so each
# node's constructor rides along even though it runs exactly once. That is a few
# KiB of one-shot code holding ITCM for the life of the image. It is accepted
# rather than filtered: 51 KiB of the region is still free, and the FILTER
# argument takes a regex over MANGLED C++ names, which stops matching on any
# rename and then relocates nothing while still linking green -- the same silent
# failure documented for the DTCM line above. A brittle filter is worse than a
# few KiB here.
#
# ORDER MATTERS: _TEXT is a COPY. The section is loaded in flash and copied to
# ITCM by z_data_copy() before main(), so it costs FLASH as well as ITCM, and
# nothing in it may run before that copy.
#
# Verify by the ITCM line of the region report, never by the build succeeding --
# the same silent-empty-fragment failure mode as the DTCM line above.
#
# NOT YET RUN ON SILICON. This links, places and reports correctly (ITCM 12,816 B,
# .itcm_text_reloc VMA 0x0 / LMA 0x004007fc), but no MR-CANHUBK344 has executed
# it -- the board is still blocked on the MCU-Link probe. The boot-time copy is
# exactly the thing a linker cannot check.
#
# TCM ECC needs no action from us: mr_canhubk3_common.dtsi already chooses both
# TCMs, so the 64-bit ECC init loops in soc_early_reset_hook are compiled in.
# See docs/tcm-relocation.md -- reading only mr_canhubk3.dts suggests otherwise
# and is wrong.
zephyr_code_relocate(LIBRARY mrm_handler_lib                   LOCATION ITCM_TEXT)
zephyr_code_relocate(LIBRARY mrm_emergency_stop_operator_lib   LOCATION ITCM_TEXT)
zephyr_code_relocate(LIBRARY mrm_comfortable_stop_operator_lib LOCATION ITCM_TEXT)

# phase-405 W4 retired MODEL, which named a RESOLVED artifact directly and so
# let the entry be built from a stale system_model.yaml. BRINGUP names the
# package instead, and the launch file inside it is what gets resolved -- the
# launch tree is the source of truth for the node/topic structure, not a
# checked-in resolution of it.
nano_ros_add_executable(zephyr_entry
    BOARD   zephyr
    BRINGUP "${CMAKE_CURRENT_SOURCE_DIR}/../safety_island_bringup"
    TYPED
    DEPLOY  zephyr)

# phase9-C4: a failing assert's file and line, for the SWD readout.
if(CONFIG_ISLAND_ASSERT_RECORD)
    target_sources(app PRIVATE src/assert_record.c)
endif()

# The MRM state on the board's LEDs (src/island_led.c, off by default).
if(CONFIG_ISLAND_LED)
    target_sources(app PRIVATE src/island_led.c)
endif()

# The visitor's SW1/SW2, recorded for the act (src/island_buttons.c, off by default).
if(CONFIG_ISLAND_BUTTONS)
    target_sources(app PRIVATE src/island_buttons.c)
endif()

# phase11-S4: the supervisor's per-spin hook (src/spin_hook.c). The spin
# thread's priority is not set here: the executor's levels are derived by
# nano-ros, each at its allocated priority (phase13-D3, nano-ros phase-509).
if(CONFIG_ISLAND_SUPERVISOR)
    target_sources(app PRIVATE src/spin_hook.c)
    zephyr_ld_options(-Wl,--wrap=nros_cpp_spin_once)
    zephyr_ld_options(-Wl,--wrap=nros_cpp_level_spin_once)
endif()

# nano-ros phase-509 I4: the executor lock's price on target (a measurement
# image only; src/island_lock_probe.c).
if(CONFIG_ISLAND_LOCK_PROBE)
    target_sources(app PRIVATE src/island_lock_probe.c)
    zephyr_ld_options(-Wl,--wrap=nros_cpp_executor_set_lock)
endif()

# phase11-S4: the supervised deadline's timer, reaction thread and SWT0
# (src/island_supervisor.c). The handler arms its route through
# island_supervisor.h.
if(CONFIG_ISLAND_SUPERVISOR)
    target_sources(app PRIVATE src/island_supervisor.c)
    # phase13-D4: the reaction thread's priority is placed from the priority
    # plan `nros codegen entry` writes beside the generated entry
    # (nros_priority_plan.h, nano-ros RFC-0079).
    target_include_directories(app PRIVATE ${CMAKE_BINARY_DIR})
endif()
```

## Kconfig
```
# The application Kconfig of this entry (phase8-W17): Zephyr's, plus the
# island's trace-window options and the assert record.
rsource "../safety_island_tracing/Kconfig.island_trace"

config ISLAND_ASSERT_RECORD
	bool "Record a failing assert's file and line for the SWD readout"
	depends on ASSERT
	default y
	help
	  phase9-C4. Overrides assert_post_action() (src/assert_record.c): the
	  first failing __ASSERT writes its file, line and uptime into
	  island_assert_record, then panics; tools/board/readout.py writes
	  assert.txt from it. The console is not wired on the board.

config ISLAND_DEBUG_FORCE_ASSERT_MS
	int "Fail an __ASSERT this many ms after boot (test only)"
	depends on ISLAND_ASSERT_RECORD
	default 0
	help
	  phase9-C4's gate: 0 (the default) is off. Never set in a committed
	  conf.

config ISLAND_DEBUG_FORCE_ASSERT_ISR
	bool "Fire the forced assert from a timer ISR instead of the work queue"
	depends on ISLAND_DEBUG_FORCE_ASSERT_MS > 0

config ISLAND_DEBUG_FORCE_ASSERT_LOCKED
	bool "Fire the forced assert under irq_lock() with the shell's lock held"
	depends on ISLAND_DEBUG_FORCE_ASSERT_MS > 0 && !ISLAND_DEBUG_FORCE_ASSERT_ISR
	depends on SHELL_BACKEND_SERIAL
	help
	  The condition of the I16 assert (dma_mcux_edma.c under irq_lock,
	  nano-ros phase-474) with the shell busy: an immediate-mode print of
	  the assert has to pend on the shell's lock with interrupts locked.

config ISLAND_LED
	bool "Show the MRM handler's state on the board's LEDs"
	depends on GPIO
	help
	  The user RGB LED (aliases led0..led2) shows the handler's MRM state
	  and CAN LED0 is a 1 Hz heartbeat, both set from the handler's own
	  10 Hz tick (src/island_led.c; rtss-work-2026-demo:docs/design/carla-island-demo.md,
	  section 3). island_led_record keeps the shown pattern and its last
	  transitions for the SWD readout (tools/board/led_readout.py).
	  Off by default: the gate image does not carry it.

config ISLAND_BUTTONS
	bool "Record the board's SW1/SW2 presses for the demo's acts"
	depends on GPIO
	help
	  SW1 (alias sw0) is the driver's takeover, SW2 (alias sw1) the
	  encore's HPC loss. Read from the MRM handler's own 10 Hz tick by the
	  GPIO driver's port read (no CTF record, no ISR), debounced over two
	  ticks, and recorded with the handler's state in island_button_record
	  (src/island_buttons.c); the act on the host reads the record over
	  SWD and does the rest (rtss-work-2026-demo:docs/design/carla-island-demo.md, section
	  3.4, unit C6). A demo affordance, not a safety function: the island
	  does not act on a press. Off by default: the gate image does not
	  carry it.

config ISLAND_LOCK_PROBE
	bool "Price the executor lock on target (nano-ros phase-509 I4)"
	depends on THREAD_ANALYZER && INIT_STACKS && THREAD_NAME
	help
	  A measurement image only (src/island_lock_probe.c): the k_mutex
	  lock cost at boot, every hold of the executor's lock (wrapping
	  nros_cpp_executor_set_lock) for L_max, and each thread's stack
	  high-water, into island_lock_probe_record for an SWD readout
	  (tools/board/lock_probe.py). Off in the gate image.

config ISLAND_LOCK_PROBE_STEADY_MS
	int "Uptime from which a hold counts as steady state (ms)"
	depends on ISLAND_LOCK_PROBE
	default 8000
	help
	  Holds and waits before this uptime (registration, the levels'
	  bring-up, the session's join) are kept apart from the steady-state
	  maxima.

config ISLAND_SUPERVISOR
	bool "Supervised deadlines: a timer and a thread outside the executor (phase11-S4)"
	depends on GPIO
	help
	  The rung that does not need the executor (docs/roadmap/
	  phase-11-supervised-budgets.md, S4; src/island_supervisor.c). A
	  k_timer is re-armed to the earliest due time of the supervised
	  routes; its expiry (ISR) wakes a reaction thread above the spin
	  thread's priority, which records a trace marker and drives the
	  safe-state output (CAN LED1, PTE5, standing in for a brake line). The
	  thread never touches the executor or the zenoh session, neither of
	  which is thread-safe. Until nano-ros carries a deadline-armed route
	  monitor (phase-11 S3), the MRM handler arms the route itself: each
	  take of the availability sets the due of the hpc_loss reaction
	  (take + max_age + call_mrm), and the call_mrm EXIT of a tick that
	  saw the loss clears it. The output latches until reset.

if ISLAND_SUPERVISOR

config ISLAND_SUPERVISOR_CALL_MRM_MS
	int "call_mrm's supervised budget (ms)"
	default 149
	help
	  The contract's mrm_handler/call_mrm max_latency (149 ms on the
	  board: tick 118 + work 31). The handler adds it to the
	  availability's max_age (its own timeout_operation_mode_availability
	  parameter) for the hpc_loss reaction's due from the last take.
	  rtss-work-2026-demo:tools/eval/analysis.py reads the due back from the trace and
	  compares it with the contract's.

config ISLAND_SUPERVISOR_STACK_SIZE
	int "Reaction thread stack (bytes)"
	default 6144
	help
	  The reaction thread runs the direct emergency path (phase11-S6):
	  the handler's and the emergency operator's publishes, CDR
	  serialisation and the zenoh-pico put included. 1024 sufficed while it
	  only drove the output.
	  4096 was 99 % used: the lock-probe image read 4,048 of 4,096 B on
	  the 300 ms overrun encore (supervisor latched; run mt-lp-ov,
	  2026-10-25), 240 B when the supervisor is not driven.

config ISLAND_SUPERVISOR_DIRECT_PERIOD_MS
	int "Direct emergency path period (ms)"
	default 33
	help
	  Once the output is latched, how often the reaction thread repeats
	  each component's direct emergency publish until that component's
	  executor path takes over (island_supervisor_handover): the
	  emergency operator's own update_rate 30.

config ISLAND_SUPERVISOR_RESUME_PERIODS
	int "Direct path resumes a slot silent this many of its periods"
	default 3
	range 2 10
	help
	  phase15-S6. After a component's executor path took its slot over
	  from the direct path (island_supervisor_handover), it reports
	  every tick that publishes the emergency, with its tick period.
	  Silent this many of its periods (the emergency operator: 3 x 33 =
	  99 ms; the handler: 3 x 100 = 300 ms), its tick is not running,
	  and the direct path resumes the slot for good: the braking command
	  (or mrm_state and the hazard lights) is back on the wire at most
	  this span plus a ms after the last tick that published it. The
	  floor's overrun rows charge the span once (docs/roadmap/
	  phase-15-supervised-floor.md, S6). 2 would resume on one late
	  tick (the executor's jitter); above 3 the gap grows past what
	  hpc_loss's 109.67 ms of slack holds.

config ISLAND_SUPERVISOR_COMFORTABLE_MS
	int "The comfortable stop's standstill deadline (ms)"
	default 10940
	help
	  Route 2 (phase11-S6, decision 4): from the handler's comfortable
	  stop call to standstill, the contract's comfortable settle at the
	  entry speed (9996.67 ms at 8.33 m/s) plus its response (943 ms),
	  rounded up to the next ms. Not at standstill by then, the comfortable
	  stop has failed and the supervisor commands the emergency stop.

config ISLAND_SUPERVISOR_EMERGENCY_MS
	int "The emergency stop's standstill deadline (ms)"
	default 4485
	help
	  Route 3 (phase15-S2, the floor): from the handler's emergency stop
	  call to standstill, the contract's emergency settle at the entry
	  speed (4165.33 ms at 8.33 m/s, target_acceleration -2.5, target_jerk
	  -1.5) plus its response (319 ms), rounded up to the next ms. Not at
	  standstill by then (plus the observation below), the supervisor
	  latches the output and the direct path brakes; the same span again
	  is the direct path's own due, and a vehicle still moving then is a
	  vehicle-side fault. phase15-S6: a vehicle-side fault needs the
	  island's braking command to have run this span (plus the
	  observation) from its start (the latch, or the direct path's
	  resume after a stalled operator); a due before that re-arms there.

config ISLAND_SUPERVISOR_EMERGENCY_RESPONSE_MS
	int "The emergency stop's response check, from the call (ms; 0: off)"
	default 1319
	range 0 4484
	help
	  Route 4 (phase16, the contract's `early: { within }` on the
	  emergency settle): the floor's response check. Armed with route 3
	  at the same start (the handler's emergency call, route 3's latch,
	  the direct path's resume), due = start + this + the standstill
	  observation below, against the |v| the island had noted when it
	  armed. By then the vehicle must have shed
	  ISLAND_SUPERVISOR_EMERGENCY_DROP_MM_S or be at standstill; if not,
	  route 3's miss runs now instead of at the settle's end (the direct
	  path if nothing is latched; the vehicle-side fault, MRM_FAILED, once
	  the island's own braking command has run this span). 1319 = the
	  response (319 ms) + 1 s of the jerk ramp (-1.5 m/s^3), by which the
	  nominal profile has shed 0.75 m/s (vehicle.braking 1.1.0's
	  settle.speed_lost; play_launch `supervised-early`). Below the
	  settle (4485): a check at its end would detect nothing earlier.

config ISLAND_SUPERVISOR_EMERGENCY_DROP_MM_S
	int "The emergency stop's response check: least speed shed (mm/s)"
	default 250
	range 1 10000
	help
	  Route 4 (phase16, the contract's `early: { drop }`): the least
	  |v| the vehicle must have shed by route 4's due, against the |v|
	  the island noted when it armed. A third of the nominal profile's
	  0.75 m/s: the rest covers a vehicle still accelerating at up to
	  1 m/s^2 through the response (0.32 m/s) and a reference sample one
	  observation (136 ms) old.

config ISLAND_SUPERVISOR_STANDSTILL_OBSERVE_MS
	int "How late the island sees a standstill (ms)"
	default 136
	help
	  Added to route 2's, route 3's and route 4's dues: the island judges the
	  standstill from its latest kinematic_state take, which comes up to
	  one sample period
	  (10 Hz, 100 ms) plus the serial link after the vehicle stopped. The
	  link is kinematic_state's own max_transport (36 ms, measured on the
	  board: 29.43 x 1.2; the contract names the runs). Without it a stop
	  inside the settle was judged late on the board (s6-b8-1: standstill
	  52 ms before the due, not yet seen on the island).

config ISLAND_SUPERVISOR_SWT
	bool "Feed SWT0 once per spin; its first timeout drives the same output"
	depends on WATCHDOG
	default y
	help
	  The S32K344's software watchdog (Zephyr wdt_nxp_s32, swt0, left
	  disabled at boot) is installed and started at the first spin, after
	  registration, and fed at the start of every spin. Its first timeout
	  raises an interrupt whose callback wakes the reaction thread: a hung
	  executor is caught even when no supervised route is pending. The
	  second consecutive timeout resets the MCU, so once the output is
	  latched the reaction thread feeds SWT0 itself: the reset is left for
	  a reaction thread that cannot run. Paused while a debugger halts the
	  core.

config ISLAND_SUPERVISOR_SWT_MS
	int "SWT0 timeout (ms)"
	depends on ISLAND_SUPERVISOR_SWT
	default 300
	help
	  Above the longest spin. island_supervisor_record.spin_gap_max_us is
	  the longest feed-to-feed gap seen since SWT0 started. The executor's
	  park ends at the next timer (33 ms, the emergency operator) and the
	  longest callback is the handler's tick (25.04 ms on the board,
	  phase9-W5).

config ISLAND_DEBUG_SPIN_STALL
	bool "Debug hook: stall the spin thread on command (test only)"
	help
	  Compiles in island_debug_spin_stall, a volatile u32 read at the
	  start of every spin. A debugger writing non-zero into it makes the
	  next spin busy-wait forever before feeding SWT0: the bench check of
	  the watchdog rung with no route pending (tools/board/
	  violations.py spin-stall). Inert while the word is 0, as it is
	  from boot: only a debugger writes it.

	  Also island_debug_late_return_ms (violations.py late-return N): the
	  next spin that answered the executor's supervised route (route 1)
	  before its due holds until N ms past that due before the supervisor
	  hears of it, once: the late notice of a route answered in time.

config ISLAND_DEBUG_FLOOR_INJECT
	bool "Debug hooks: the floor's three failures, on command (test only)"
	help
	  phase15-S4. Never in the gate or booth image: only the snippet
	  island-floor-inject (just board-build-floor-inject, build-board-
	  floor-inject) sets it, and without it the words below do not exist.
	  Each is a volatile u32, 0 from boot and inert while 0; only a
	  debugger writes one (tools/board/violations.py floor-inject
	  drop|stall|hold [mm/s]), for rtss-work-2026-demo's floor acts:
	    island_debug_floor_drop     the handler's next emergency operate
	                                request is not sent (route 3 is still
	                                armed), once: the request is lost;
	    island_debug_floor_stall    from its next tick in OPERATING the
	                                emergency operator's timer does
	                                nothing (no command, no status): its
	                                tick is not running. The level still
	                                spins, so SWT0 is fed and route 3 is
	                                what sees it; 2 (stall-after): only
	                                once it has taken the command over
	                                from the direct path (the handover);
	    island_debug_floor_hold_mm_s the speed the handler sees in
	                                kinematic_state (its own isStopped()
	                                and route 3's sample) reads this many
	                                mm/s while non-zero: the vehicle does
	                                not decelerate, as far as the island
	                                can tell.
	  Each records SUPERVISOR_INJECT when taken (0xfffffffc drop,
	  0xfffffffb stall, 0xfffffff9 stall-after, 0xfffffffa hold).

endif

source "Kconfig.zephyr"
```

## prj.conf
```kconfig
# P4 zephyr base config — safety-island C++ entry (4 ported nodes).
# RMW + sizing come from the prj-cyclonedds.conf overlay.

CONFIG_LOG=y
CONFIG_LOG_DEFAULT_LEVEL=3
CONFIG_PRINTK=y
CONFIG_EARLY_CONSOLE=y

CONFIG_NETWORKING=y
CONFIG_NET_IPV4=y
CONFIG_NET_UDP=y
CONFIG_NET_SOCKETS=y
CONFIG_NET_L2_ETHERNET=y
CONFIG_NET_MAX_CONTEXTS=32
CONFIG_DNS_RESOLVER=n

CONFIG_SYS_CLOCK_TICKS_PER_SEC=1000

CONFIG_NROS=y
CONFIG_NROS_C_API=y
CONFIG_NROS_CPP_API=y
CONFIG_STD_CPP17=y # class headers use nested namespaces (RFC-0057)
```

## prj-cyclonedds.conf
```kconfig
# RMW overlay: Cyclone DDS backend (Phase 117 / 169.5).
#
# Cyclone DDS is C++-only (depends on NROS_CPP_API). The C side
# can't select it.

CONFIG_NROS_RMW_CYCLONEDDS=y

# RTPS uses UDP multicast for SPDP discovery.
CONFIG_NET_IPV4_IGMP=y
CONFIG_POSIX_API=y
CONFIG_MAX_PTHREAD_MUTEX_COUNT=256
CONFIG_MAX_PTHREAD_COND_COUNT=256
CONFIG_POSIX_THREAD_THREADS_MAX=16

# Resource sizing — Cyclone is heavy.
CONFIG_MAIN_STACK_SIZE=524288
CONFIG_HEAP_MEM_POOL_SIZE=4194304
CONFIG_SYSTEM_WORKQUEUE_STACK_SIZE=8192

CONFIG_NET_PKT_RX_COUNT=64
CONFIG_NET_PKT_TX_COUNT=64
CONFIG_NET_BUF_RX_COUNT=128
CONFIG_NET_BUF_TX_COUNT=128

# Phase 11W.12 — runtime parity with the Rust cyclonedds overlay.
# The universal bool configs (THREAD_LOCAL_STORAGE / THREAD_CUSTOM_DATA
# / DYNAMIC_THREAD(+ALLOC) / THREAD_STACK_INFO / THREAD_MONITOR) come
# from CONFIG_NROS_RMW_CYCLONEDDS in zephyr/Kconfig. The int knobs +
# native_sim NSOS offload are example-local:
#   COMMON_LIBC_MALLOC_ARENA_SIZE — Cyclone's participant init does
#     many small mallocs; the ARCH_POSIX default (16 KiB) trips
#     ddsrt_malloc → CODE_UNREACHABLE in picolibc libc-hooks. 16 MiB
#     gives ample headroom.
#   DYNAMIC_THREAD_STACK_SIZE — per-worker-thread stack.
# 16 MiB sufficed while the domain bridges scoped the island to ~8 topics;
# the direct connection (island on Autoware's domain) makes cyclone build
# proxies for the ENTIRE sim graph (~68 composables, thousands of remote
# endpoints) and the arena blows at participant discovery (ddsrt_malloc ->
# abort at t=0 when joining a running stack). native_sim can afford RAM.
CONFIG_COMMON_LIBC_MALLOC_ARENA_SIZE=268435456
CONFIG_DYNAMIC_THREAD_STACK_SIZE=32768

# NET_TCP — sockwaitset self-pipe (loopback TCP socket pair). Kept
# here because selecting it from NROS_RMW_CYCLONEDDS forms a Kconfig
# dependency loop through NET_SOCKETS.
CONFIG_NET_TCP=y

# Diagnostics — verbose asserts + immediate logging keep Cyclone init
# failures legible (picolibc drops fprintf(stderr)).
CONFIG_ASSERT=y
CONFIG_ASSERT_VERBOSE=y
CONFIG_PICOLIBC_ASSERT_VERBOSE=y
CONFIG_LOG_MODE_IMMEDIATE=y

# Phase 11W.8 — force NSOS (board overlay not auto-applied under
# explicit CONF_FILE). Host BSD sockets instead of zeth/TAP.
# native_sim-only; real hardware uses its actual net stack.
#
# ETH_NATIVE_POSIX=n is part of that profile and was the line this copy
# missed. nano-ros states why in cmake/zephyr/native-sim-line-3.7.conf:
# "The native eth driver is disabled so it doesn't try to create a zeth
# TAP." Left on, the driver runs anyway and logs
#     <err> eth_posix: Cannot create zeth (0)
# because /dev/net/tun needs root. The participant is still created -- the
# damage is downstream: Cyclone's receive thread then spins on
#     <inf> cyclonedds: cyclone: os_sockWaitsetWait: select failed
# forever, so the island never joins the graph, publishes no MrmState, and
# Autoware refuses to engage. Measured: 93 million log lines and 8.8 GB of
# tmp_island.log in one demo run, VERDICT FAIL with mrm=None/None.
CONFIG_ETH_NATIVE_POSIX=n
CONFIG_NET_DRIVERS=y
CONFIG_NET_SOCKETS_OFFLOAD=y
CONFIG_NET_NATIVE_OFFLOADED_SOCKETS=y

# Cyclone's socket waitset selects on more descriptors than Zephyr's
# default poll set holds. NET_SOCKETS_POLL_MAX defaults to 3; one
# participant already needs the unicast data socket, the discovery socket
# and the waitset self-pipe, and `zsock_select` rejects the whole set
# rather than truncating it. The symptom is a select() that fails on the
# first call and every call after, logged as
#     <inf> cyclonedds: cyclone: os_sockWaitsetWait: select failed
# in a tight loop that never yields -- 7.7 million lines in one run --
# while the participant itself was created fine, so nothing upstream
# reports an error.
CONFIG_NET_SOCKETS_POLL_MAX=16

# ── safety-island additions ─────────────────────────────────────────────────
# Compile-time domain id (embedded rule — never runtime env). Domain 10 =
# Autoware's own domain for this demo: the island talks to the stack DIRECTLY
# (the domain-bridge middle-man is gone since the direct-connection
# restructure).
#
# 10 rather than the obvious 1 because this build host is shared: another
# project's Autoware occupies domains 1-3, and a DDS domain is a shared
# namespace — two Autoware stacks on one domain fight over participant indices
# and each other's topics. Symptom when that happens: no participant can be
# created on the domain at all ("rmw handle is invalid" for every host node,
# the sim half-starting with 0/13 containers), which reads as a bug in whatever
# you changed last. Keep this in step with the justfile's ROS_DOMAIN_ID default
# and with `domain_id` in both system.toml files: the island bakes its domain
# at compile time and cannot pick it up from the environment.
CONFIG_NROS_CYCLONE_DOMAIN_ID=10
# 4 ported nodes ≈ 30+ DDS entities, each with mutex+cond — the example
# default (256) exhausted mid-boot (ddsrt_mutex_init abort in the LAST
# node's ctor; the documented MAX_PTHREAD_MUTEX_COUNT pitfall, scaled).
#
# 16384 was in turn exhausted by the FULL Autoware graph: cyclone took one
# pool mutex per proxy entity AND one per addrset, so the count scaled with the
# remote endpoint count, not with our own. It hit exactly 16384/16384 ~19 s
# into SEDP ingestion and the next ddsrt_mutex_init silently failed — nano-ros
# issue 0371, which needed 131072 slots (~4.1 MiB of static RAM) to clear.
#
# ...and then the whole term went away. Cyclone's ddsrt now uses a Zephyr-NATIVE
# sync backend (issue 0496): ddsrt_mutex_t is an embedded `struct k_mutex` and
# ddsrt_cond_t an embedded `struct k_condvar`, so neither takes a slot from
# Zephyr's fixed pthread pools at all. The pool no longer scales with anything
# cyclone does, which is why these are back to the example defaults after having
# been walked up 256 -> 16384 -> 131072 chasing the graph size.
#
# They are not zero because Zephyr's POSIX layer is still used for THREADS
# (cyclone calls pthread_create) and for the single rwlock in ddsrt/src/log.c,
# neither of which scales with the graph.
CONFIG_MAX_PTHREAD_MUTEX_COUNT=256
CONFIG_MAX_PTHREAD_COND_COUNT=256

# Compile-time cyclone config (nano-ros issue 0367 wired the knob; env
# CYCLONEDDS_URI is invisible to native_sim). Direct-connection profile:
# multicast OFF (NSOS breaks cyclone's multicast waitset — phase 180) +
# unicast 127.0.0.1 peer scan WIDENED to 250 indices so the island can
# discover every participant of the Autoware stack on the demo domain (cyclone's
# default range of 9/baked 20 overflows on ~40 processes; overflowed
# participants take random ports and stay invisible to unicast scan
# forever). Sizing/Threads carried over from the nano-ros baked profile.
# Single-quoted XML attributes — Kconfig strings can't escape doubles.
CONFIG_NROS_CYCLONE_CONFIG_XML="<CycloneDDS><Domain Id='any'><General><AllowMulticast>false</AllowMulticast></General><Discovery><ParticipantIndex>auto</ParticipantIndex><MaxAutoParticipantIndex>120</MaxAutoParticipantIndex><Peers><Peer Address='127.0.0.1'/></Peers></Discovery><Sizing><ReceiveBufferSize>64 KiB</ReceiveBufferSize><ReceiveBufferChunkSize>16 KiB</ReceiveBufferChunkSize></Sizing><Threads><Thread Name='dq.builtins'><StackSize>64 KiB</StackSize></Thread></Threads><Tracing><Verbosity>warning</Verbosity><OutputFile>stdout</OutputFile></Tracing></Domain></CycloneDDS>"
CONFIG_THREAD_NAME=y
CONFIG_THREAD_MAX_NAME_LEN=32
```

## boards/mr_canhubk3_s32k344.overlay
```dts
/*
 * TCM chosen nodes.
 *
 * S32K3 TCM is ECC-protected, and the reference manual requires the whole
 * region be written by a 64-bit master after a destructive reset before any
 * 32-bit master reads or writes it. Zephyr's `soc_early_reset_hook`
 * (soc/nxp/s32/s32k3/s32k3xx_startup.S) does exactly that with a `stm {r0,r3}`
 * loop — but the ITCM and DTCM loops are compiled out unless these chosen
 * nodes exist. The board defines the memory regions and does NOT choose them,
 * so on a stock mr_canhubk3 both TCMs stay ECC-uninitialised.
 *
 * That matters as soon as anything is relocated there. Zeroing relocated .bss
 * from C is a 32-bit store, which is the access the manual says must come
 * AFTER the 64-bit initialisation, not instead of it.
 */
/ {
	chosen {
		zephyr,itcm = &itcm;
		zephyr,dtcm = &dtcm;
	};
};
```

## src/main.cpp
```c
// Entry pkg — boots the safety-island topology on the Zephyr board.
// The generated entry owns the real main; this is the doc/IDE hint.

#include <nros/main.hpp>

NROS_MAIN(::nros::board::ZephyrBoard, "safety_island_bringup");
```

## src/assert_record.c
```c
/*
 * A failing assert, recorded where SWD can read it (phase9-C4).
 *
 * The board's console (lpuart0) is not wired, so an assert's printed line is
 * lost even when it prints. This overrides Zephyr's weak assert_post_action()
 * (lib/os/assert.c): the first failing assert writes its file, line, uptime and
 * context into `island_assert_record`, then panics as Zephyr's would. The
 * SWD readout (tools/board/readout.py, assert.txt) decodes it; the file
 * pointer is a string in flash, resolved from the ELF.
 *
 * An assert that fires while the first one is being handled (the fault path
 * asserting on its own printing, the recursion phase9-C4 found) is recorded in
 * the `nested_*` fields and halts on the spot: the first record is the one
 * that matters, and a second k_panic() from inside the fatal handler only
 * escalates to a fault that loses it.
 *
 * Cost: one 32 B record in .bss (the app library's .bss is in DTCM,
 * CMakeLists.txt) and one small function in flash.
 */
#include <stdint.h>
#include <zephyr/arch/cpu.h>
#include <zephyr/fatal.h>
#include <zephyr/init.h>
#include <zephyr/kernel.h>
#include <zephyr/sys/__assert.h>
#if defined(CONFIG_ISLAND_DEBUG_FORCE_ASSERT_LOCKED)
#include <zephyr/shell/shell.h>
#include <zephyr/shell/shell_uart.h>
#endif

#define ISLAND_ASSERT_MAGIC 0x54525341u /* "ASRT" little-endian */

/* Layout read by tools/board/readout.py (ASSERT_FIELDS); all 32-bit. */
struct island_assert_record {
	uint32_t magic;       /* ISLAND_ASSERT_MAGIC once a record is written */
	uint32_t count;       /* failing asserts seen, nested ones included */
	const char *file;     /* __FILE__ of the first */
	uint32_t line;        /* __LINE__ of the first */
	uint32_t uptime_ms;   /* k_uptime_get_32() at the first */
	uint32_t in_isr;      /* 1: the first fired in an ISR or exception */
	const char *nested_file; /* the first assert that fired while handling it */
	uint32_t nested_line;
};

volatile struct island_assert_record island_assert_record;

void assert_post_action(const char *file, unsigned int line)
{
	unsigned int key = irq_lock();
	uint32_t n = island_assert_record.count + 1U;

	island_assert_record.count = n;
	if (n == 1U) {
		island_assert_record.file = file;
		island_assert_record.line = line;
		island_assert_record.uptime_ms = k_uptime_get_32();
		island_assert_record.in_isr = k_is_in_isr() ? 1U : 0U;
		__DMB();
		island_assert_record.magic = ISLAND_ASSERT_MAGIC;
	} else {
		if (island_assert_record.nested_file == NULL) {
			island_assert_record.nested_file = file;
			island_assert_record.nested_line = line;
		}
		k_fatal_halt(K_ERR_KERNEL_PANIC);
	}
	irq_unlock(key);
	k_panic();
	CODE_UNREACHABLE;
}

#if CONFIG_ISLAND_DEBUG_FORCE_ASSERT_MS > 0
/* Test only: one failing __ASSERT this long after boot (phase9-C4's gate). */
static volatile int island_debug_assert_holds;

static void island_debug_assert(void)
{
#if defined(CONFIG_ISLAND_DEBUG_FORCE_ASSERT_LOCKED)
	/* The I16 condition: interrupts locked and the shell's lock held
	 * elsewhere, so an immediate-mode print of the assert has to pend. */
	const struct shell *sh = shell_backend_uart_get_ptr();

	(void)k_sem_take(&sh->ctx->lock_sem, K_FOREVER);
	unsigned int key = irq_lock();
#endif
	__ASSERT(island_debug_assert_holds, "forced by CONFIG_ISLAND_DEBUG_FORCE_ASSERT_MS");
#if defined(CONFIG_ISLAND_DEBUG_FORCE_ASSERT_LOCKED)
	irq_unlock(key);
#endif
}

#if defined(CONFIG_ISLAND_DEBUG_FORCE_ASSERT_ISR)
static void island_debug_assert_timer(struct k_timer *t)
{
	ARG_UNUSED(t);
	island_debug_assert();
}
K_TIMER_DEFINE(island_debug_assert_tm, island_debug_assert_timer, NULL);
#else
static void island_debug_assert_work(struct k_work *w)
{
	ARG_UNUSED(w);
	island_debug_assert();
}
K_WORK_DELAYABLE_DEFINE(island_debug_assert_dw, island_debug_assert_work);
#endif

static int island_debug_assert_arm(void)
{
#if defined(CONFIG_ISLAND_DEBUG_FORCE_ASSERT_ISR)
	k_timer_start(&island_debug_assert_tm, K_MSEC(CONFIG_ISLAND_DEBUG_FORCE_ASSERT_MS), K_NO_WAIT);
#else
	k_work_schedule(&island_debug_assert_dw, K_MSEC(CONFIG_ISLAND_DEBUG_FORCE_ASSERT_MS));
#endif
	return 0;
}
SYS_INIT(island_debug_assert_arm, APPLICATION, 99);
#endif
```

## src/spin_hook.c
```c
/*
 * The supervisor's per-spin hook (phase11-S4): the executor's spin entry
 * points, nros_cpp_spin_once (the adopted level) and, since nano-ros phase-509
 * P9b, nros_cpp_level_spin_once (each spawned level's worker), are wrapped
 * (-Wl,--wrap) so that every spin checks
 * its level in for SWT0 and, after it, the level that owns route 1 re-arms it
 * from its executor's earliest supervised due (island_supervisor.c). The
 * handle names the core's one executor; the entry point names the level.
 *
 * phase13-D3: this file used to be spin_priority.c and also raised the spin
 * thread to CONFIG_ISLAND_SPIN_THREAD_PRIORITY (3) on the first spin. The
 * executor's levels are derived by nano-ros, each at a priority allocated
 * from the contract and the image's priority plan; the runner registers at
 * CONFIG_MAIN_THREAD_PRIORITY and each level adopts its priority before its
 * first spin, which is what the raise did by hand.
 */
#include <stdint.h>
#include <zephyr/kernel.h>
#include "island_supervisor.h"

int __real_nros_cpp_spin_once(void *handle, int32_t timeout_ms);
int __real_nros_cpp_level_spin_once(void *scheduler, uint8_t level, int32_t timeout_ms);
int nros_cpp_executor_level(void *handle, uint8_t *out_level);
#ifdef CONFIG_ISLAND_LOCK_PROBE
/* nano-ros issue 2065: a spawned level's setup and steady stack peaks
 * (island_lock_probe.c, section 4). */
void island_lock_probe_level_pass(void);
#endif
void *nros_cpp_scheduler_owner(void *scheduler);

/* The adopted level (it owns the core's executor and runs on main()). */
int __wrap_nros_cpp_spin_once(void *handle, int32_t timeout_ms)
{
	uint8_t level = 0xFFu;

	(void)nros_cpp_executor_level(handle, &level);
	island_supervisor_spin(handle, level);
	const int rc = __real_nros_cpp_spin_once(handle, timeout_ms);

	island_supervisor_spin_after(handle, level);
	return rc;
}

/* nano-ros phase-509 P9b: a spawned level, a worker over the same executor. */
int __wrap_nros_cpp_level_spin_once(void *scheduler, uint8_t level, int32_t timeout_ms)
{
#ifdef CONFIG_ISLAND_LOCK_PROBE
	island_lock_probe_level_pass();
#endif
	void *executor = nros_cpp_scheduler_owner(scheduler);

	island_supervisor_spin(executor, level);
	const int rc = __real_nros_cpp_level_spin_once(scheduler, level, timeout_ms);

	island_supervisor_spin_after(executor, level);
	return rc;
}
```

## src/spin_priority.c
```c
/*
 * The executor's priority once registration is done (phase9 spin latency).
 *
 * The main thread registers every entity BELOW zenoh-pico's read task
 * (CONFIG_MAIN_THREAD_PRIORITY 5 against the read task's k_thread 4,
 * phase8-W10): while it registers, the read task must drain the serial RX
 * ring, or the router's answers to the island's interests are lost. The same
 * main thread then runs the executor, and at 5 the transport's read, flush and
 * lease tasks (all k_thread 4) run ahead of a release that is due: 1.7 ms
 * median of every late spin in sl-rclcpp-diag.
 *
 * The first spin is after registration (nros_cpp_spin_once is the executor's
 * single entry point, as native_sim's sim_clock_catch_up.c relies on), so
 * this raises the spin thread there, once.
 *
 * phase11-S4: the same entry point feeds the supervisor's SWT0, once per
 * spin (island_supervisor.c), so this wrapper is linked when either option
 * is on.
 */
#include <stdbool.h>
#include <stdint.h>
#include <zephyr/kernel.h>
#if defined(CONFIG_ISLAND_SUPERVISOR)
#include "island_supervisor.h"
#endif

int __real_nros_cpp_spin_once(void *handle, int32_t timeout_ms);

int __wrap_nros_cpp_spin_once(void *handle, int32_t timeout_ms)
{
#if defined(CONFIG_ISLAND_SPIN_RAISE)
	static bool raised;

	if (!raised) {
		raised = true;
		k_thread_priority_set(k_current_get(), CONFIG_ISLAND_SPIN_THREAD_PRIORITY);
	}
#endif
#if defined(CONFIG_ISLAND_SUPERVISOR)
	island_supervisor_spin();
	const int rc = __real_nros_cpp_spin_once(handle, timeout_ms);

	island_supervisor_spin_after(handle);
	return rc;
#else
	return __real_nros_cpp_spin_once(handle, timeout_ms);
#endif
}
```
