## CMakeLists.txt
```
# Zephyr native_sim entry (`just zephyr-build`): all four ported Autoware
# nodes in one zephyr.exe, on Cyclone DDS, joining Autoware's domain directly
# (the legacy Cyclone demo's island; that demo is retired, phase 14).
#
#   west build -b native_sim/native/64 -d build-zephyr src/native_sim_entry \
#     -- -DCONF_FILE="prj.conf;prj-cyclonedds.conf" -DZEPHYR_EXTRA_MODULES=<nano-ros>
#
# WHY A SECOND ENTRY PACKAGE (2026-09-21, nano-ros f0d191c98). This image and
# the board's (src/zephyr_entry) used to be ONE package built two ways:
# -DCONF_FILE for native_sim/Cyclone, `-S nros-zenoh` for the board. nano-ros
# resolves an image from its entry package (`nros image-facts --for-entry`,
# first match) and refuses a west build whose Kconfig RMW disagrees with the
# image's declared `rmw` (cmake/NanoRosImageAgreement.cmake). One package
# declares one `rmw`, so the two builds could not both pass; nano-ros's own
# examples/workspaces/cpp keeps `zephyr_entry` (zenoh) beside
# `zephyr_cyclonedds_entry` for exactly this reason and says so in its
# demo_bringup/system.toml. So: one entry per (board, RMW) variant. Board-only
# policy -- the TCM relocation, boards/, snippets/ -- stays with the board
# entry; this one is the plain image.

cmake_minimum_required(VERSION 3.20.0)

# Workspace-local msg pkgs resolve through the auto-emitted Find-stubs -- the
# search path must be visible before nano_ros's stub machinery loads.
set(NROS_INTERFACE_SEARCH_PATH "${CMAKE_CURRENT_SOURCE_DIR}/..")

find_package(Zephyr REQUIRED HINTS $ENV{ZEPHYR_BASE})
project(safety_island_native_sim_entry)

# Pin nano_ros to the submodule, for the reason src/zephyr_entry/CMakeLists.txt
# gives at length: unpinned, find_package() is free to pick any checkout on
# CMAKE_PREFIX_PATH, and the failure lands far from the cause (unbounded-type
# errors in messages nobody touched). An explicit -Dnano_ros_DIR= still wins.
if(NOT DEFINED nano_ros_DIR)
    set(nano_ros_DIR "${CMAKE_CURRENT_SOURCE_DIR}/../../third-party/nano-ros"
        CACHE PATH "nano-ros checkout backing this island (default: the submodule)")
endif()
find_package(nano_ros REQUIRED)
get_filename_component(_nros_resolved "${nano_ros_DIR}" REALPATH)
get_filename_component(_nros_expected "${CMAKE_CURRENT_SOURCE_DIR}/../../third-party/nano-ros" REALPATH)
if(NOT _nros_resolved STREQUAL _nros_expected)
    message(WARNING
        "nano_ros resolved to ${_nros_resolved}, NOT this repo's submodule at "
        "${_nros_expected}. That is supported, but say so deliberately -- an "
        "ACCIDENTAL one produces unbounded-type errors in untouched messages.")
endif()

if(NOT COMMAND nano_ros_workspace_pkg_guard)
    function(nano_ros_workspace_pkg_guard)
    endfunction()
endif()

# Interface union first (one superset FFI archive -- nano-ros #253), then the
# node component libs the model names.
add_subdirectory("${CMAKE_CURRENT_SOURCE_DIR}/../island_interfaces" island_interfaces)
add_subdirectory("${CMAKE_CURRENT_SOURCE_DIR}/../autoware_mrm_emergency_stop_operator" autoware_mrm_emergency_stop_operator)
add_subdirectory("${CMAKE_CURRENT_SOURCE_DIR}/../autoware_mrm_comfortable_stop_operator" autoware_mrm_comfortable_stop_operator)
add_subdirectory("${CMAKE_CURRENT_SOURCE_DIR}/../autoware_mrm_handler" autoware_mrm_handler)

# BRINGUP names the package a human authors; the launch tree inside it is what
# `nros sync` resolves (src/zephyr_entry/CMakeLists.txt records why MODEL,
# which named a resolved artifact, is gone).
nano_ros_add_executable(native_sim_entry
    BOARD   zephyr
    BRINGUP "${CMAKE_CURRENT_SOURCE_DIR}/../safety_island_bringup"
    TYPED
    DEPLOY  zephyr)

# phase8-W29: the executor's first spin waits for native_sim's simulated clock
# to catch up with the host, so the boot stall is not replayed as a sprint the
# island's timers see (the reasoning is in src/sim_clock_catch_up.c).
target_sources(app PRIVATE src/sim_clock_catch_up.c)
zephyr_ld_options(-Wl,--wrap=nros_cpp_spin_once)
```

## prj.conf
```kconfig
# Zephyr base config for the native_sim entry (4 ported nodes). The RMW and
# its sizing come from the prj-cyclonedds.conf overlay. Same base as
# src/zephyr_entry/prj.conf, the board entry; the two diverge only in how the
# RMW is selected (an overlay here, a `-S nros-zenoh` snippet there).

CONFIG_LOG=y
CONFIG_LOG_DEFAULT_LEVEL=3
CONFIG_PRINTK=y
CONFIG_EARLY_CONSOLE=y

CONFIG_NETWORKING=y
CONFIG_NET_IPV4=y
CONFIG_NET_UDP=y
CONFIG_NET_SOCKETS=y
CONFIG_NET_L2_ETHERNET=y
CONFIG_NET_MAX_CONTEXTS=32
# phase8-W18: the island's wall clock. Its MRM commands are read by Autoware's
# vehicle_cmd_gate, which keeps its previous hazard/turn/gear command when the
# new one is stamped EARLIER -- and a boot-relative stamp always is, so the
# hazard lights never came on in an MRM. nano-ros acquires the UNIX epoch once
# at boot, before any component is constructed (issue 0758), from
# scripts/sntp-server.py, which the island recipes start beside zephyr.exe.
# NSOS offloads the socket to the host, hence 127.0.0.1 and an unprivileged
# port. No answer is not fatal: the stamps stay boot-relative, as before.
# NROS_SNTP_EPOCH selects DNS_RESOLVER (it was =n here); the server is a
# numeric address, so no query is ever sent.
CONFIG_NROS_SNTP_EPOCH=y
CONFIG_NROS_SNTP_SERVER="127.0.0.1:12323"
CONFIG_NROS_SNTP_TIMEOUT_MS=3000

CONFIG_SYS_CLOCK_TICKS_PER_SEC=1000

CONFIG_NROS=y
CONFIG_NROS_C_API=y
CONFIG_NROS_CPP_API=y
CONFIG_STD_CPP17=y # class headers use nested namespaces (RFC-0057)

# == phase7-W1 tracing (docs/tracing.md) =====================================
# Synchronous CTF into a RAM buffer, dumped to a file at exit
# (`zephyr.exe --trace-out=<file>`, `just trace-native`). The same design as
# the board block at the end of src/zephyr_entry/boards/mr_canhubk3_s32k344.conf,
# so the image under emulation writes through the same backend code path.
#
# WHY SYNC + RAM. TRACING_LOCK() is irq_lock() around the WHOLE backend write,
# so a synchronous event costs whatever the backend costs, paid with
# interrupts off. UART (the default backend) is a byte-at-a-time poll loop,
# semihost traps to a debugger and faults without one, and ASYNC drops whole
# events into a counter nothing reads. RAM is a bounds check and a memcpy.
# The POSIX backend (native_sim only) is not used: it would be a host fwrite
# under the lock, a code path the board never runs.
CONFIG_TRACING=y
CONFIG_TRACING_CTF=y
CONFIG_TRACING_SYNC=y
CONFIG_TRACING_BACKEND_RAM=y
# One-shot, not a ring: when full the backend latches and drops everything
# after. 64 MiB is host RAM (native_sim) and covers a full demo run; the
# check reports a buffer that filled before the run ended.
CONFIG_RAM_TRACING_BUFFER_SIZE=67108864
# The CUT event set: application markers (island_trace.h) + thread switches.
# TRACING_THREAD is the only Kconfig that carries switched_in/out, and it also
# brings thread create/start/wakeup/name/priority/info events (rare). On this
# 3.7 line isr_enter/isr_exit and idle are emitted by the native_sim board and
# arch unconditionally (no TRACING_ISR / TRACING_IDLE gate); they are 5 bytes
# each and are counted by `just trace-decode`.
CONFIG_TRACING_THREAD=y
CONFIG_TRACING_SYSCALL=n
CONFIG_TRACING_WORK=n
CONFIG_TRACING_ISR=n
CONFIG_TRACING_SEMAPHORE=n
CONFIG_TRACING_MUTEX=n
CONFIG_TRACING_CONDVAR=n
CONFIG_TRACING_QUEUE=n
CONFIG_TRACING_FIFO=n
CONFIG_TRACING_LIFO=n
CONFIG_TRACING_STACK=n
CONFIG_TRACING_MESSAGE_QUEUE=n
CONFIG_TRACING_MAILBOX=n
CONFIG_TRACING_PIPE=n
CONFIG_TRACING_HEAP=n
CONFIG_TRACING_MEMORY_SLAB=n
CONFIG_TRACING_TIMER=n
CONFIG_TRACING_EVENT=n
CONFIG_TRACING_POLLING=n
CONFIG_TRACING_PM=n
CONFIG_TRACING_NETWORKING=n
# == end phase7-W1 tracing ====================================================

# == phase9-W4: runtime contract violations (rtss-work-2026-demo:docs/takeover-trace.md s. 12) ====
# As the board conf (mr_canhubk3_s32k344.conf, the phase9-W4 block): monitors
# armed by the handler's rclcpp::arm_monitors() on the first tick with every
# input established, and the executor's violation markers forwarded into the
# trace at island ids 277-280. Unlike the board, this console is read, so the
# drain-and-report hook is ON: each stored verdict is a "contract violation
# #N: <rule> <fqn> measured=.. declared=.. (total=.. dropped=..)" line in
# the island's log. No SWD record here (no CONFIG_NROS_BOOT_REPORT).
CONFIG_NROS_MONITOR_ARM_ON_CALL=y
CONFIG_NROS_TRACE_CALLBACKS=y
# phase9-W4 rerun (phase-474 I3), as the board conf: takes traced so the
# island binds its three F4 inputs (forwarded at 281-283), one timer tick in
# ten keeps nano-ros's start/end pair (the emergency operator's every tick).
CONFIG_NROS_TRACE_TAKES=y
CONFIG_NROS_TRACE_TIMER_EVERY=10
# phase10-B3: the ring depth (8) is `[image.native_sim.knobs.executor]
# max_violations` in system.toml; the nano-ros pin refuses it here.
CONFIG_NROS_VIOLATION_DRAIN_REPORT=y
# == end phase9-W4 ============================================================
```

## prj-cyclonedds.conf
```kconfig
# RMW overlay: Cyclone DDS backend (Phase 117 / 169.5).
#
# Cyclone DDS is C++-only (depends on NROS_CPP_API). The C side
# can't select it.

CONFIG_NROS_RMW_CYCLONEDDS=y

# RTPS uses UDP multicast for SPDP discovery.
CONFIG_NET_IPV4_IGMP=y
CONFIG_POSIX_API=y
CONFIG_MAX_PTHREAD_MUTEX_COUNT=256
CONFIG_MAX_PTHREAD_COND_COUNT=256
CONFIG_POSIX_THREAD_THREADS_MAX=16

# Resource sizing — Cyclone is heavy.
CONFIG_MAIN_STACK_SIZE=524288
CONFIG_HEAP_MEM_POOL_SIZE=4194304
CONFIG_SYSTEM_WORKQUEUE_STACK_SIZE=8192

CONFIG_NET_PKT_RX_COUNT=64
CONFIG_NET_PKT_TX_COUNT=64
CONFIG_NET_BUF_RX_COUNT=128
CONFIG_NET_BUF_TX_COUNT=128

# Phase 11W.12 — runtime parity with the Rust cyclonedds overlay.
# The universal bool configs (THREAD_LOCAL_STORAGE / THREAD_CUSTOM_DATA
# / DYNAMIC_THREAD(+ALLOC) / THREAD_STACK_INFO / THREAD_MONITOR) come
# from CONFIG_NROS_RMW_CYCLONEDDS in zephyr/Kconfig. The int knobs +
# native_sim NSOS offload are example-local:
#   COMMON_LIBC_MALLOC_ARENA_SIZE — Cyclone's participant init does
#     many small mallocs; the ARCH_POSIX default (16 KiB) trips
#     ddsrt_malloc → CODE_UNREACHABLE in picolibc libc-hooks. 16 MiB
#     gives ample headroom.
#   DYNAMIC_THREAD_STACK_SIZE — per-worker-thread stack.
# 16 MiB sufficed while the domain bridges scoped the island to ~8 topics;
# the direct connection (island on Autoware's domain) makes cyclone build
# proxies for the ENTIRE sim graph (~68 composables, thousands of remote
# endpoints) and the arena blows at participant discovery (ddsrt_malloc ->
# abort at t=0 when joining a running stack). native_sim can afford RAM.
CONFIG_COMMON_LIBC_MALLOC_ARENA_SIZE=268435456
CONFIG_DYNAMIC_THREAD_STACK_SIZE=32768

# NET_TCP — sockwaitset self-pipe (loopback TCP socket pair). Kept
# here because selecting it from NROS_RMW_CYCLONEDDS forms a Kconfig
# dependency loop through NET_SOCKETS.
CONFIG_NET_TCP=y

# Diagnostics — verbose asserts + immediate logging keep Cyclone init
# failures legible (picolibc drops fprintf(stderr)).
CONFIG_ASSERT=y
CONFIG_ASSERT_VERBOSE=y
CONFIG_PICOLIBC_ASSERT_VERBOSE=y
CONFIG_LOG_MODE_IMMEDIATE=y

# Phase 11W.8 — force NSOS (board overlay not auto-applied under
# explicit CONF_FILE). Host BSD sockets instead of zeth/TAP.
# native_sim-only; real hardware uses its actual net stack.
#
# ETH_NATIVE_POSIX=n is part of that profile and was the line this copy
# missed. nano-ros states why in cmake/zephyr/native-sim-line-3.7.conf:
# "The native eth driver is disabled so it doesn't try to create a zeth
# TAP." Left on, the driver runs anyway and logs
#     <err> eth_posix: Cannot create zeth (0)
# because /dev/net/tun needs root. The participant is still created -- the
# damage is downstream: Cyclone's receive thread then spins on
#     <inf> cyclonedds: cyclone: os_sockWaitsetWait: select failed
# forever, so the island never joins the graph, publishes no MrmState, and
# Autoware refuses to engage. Measured: 93 million log lines and 8.8 GB of
# tmp_island.log in one demo run, VERDICT FAIL with mrm=None/None.
CONFIG_ETH_NATIVE_POSIX=n
CONFIG_NET_DRIVERS=y
CONFIG_NET_SOCKETS_OFFLOAD=y
CONFIG_NET_NATIVE_OFFLOADED_SOCKETS=y

# Cyclone's socket waitset selects on more descriptors than Zephyr's
# default poll set holds. NET_SOCKETS_POLL_MAX defaults to 3; one
# participant already needs the unicast data socket, the discovery socket
# and the waitset self-pipe, and `zsock_select` rejects the whole set
# rather than truncating it. The symptom is a select() that fails on the
# first call and every call after, logged as
#     <inf> cyclonedds: cyclone: os_sockWaitsetWait: select failed
# in a tight loop that never yields -- 7.7 million lines in one run --
# while the participant itself was created fine, so nothing upstream
# reports an error.
CONFIG_NET_SOCKETS_POLL_MAX=16

# ── safety-island additions ─────────────────────────────────────────────────
# Compile-time domain id (embedded rule — never runtime env). Domain 10 =
# Autoware's own domain for this demo: the island talks to the stack DIRECTLY
# (the domain-bridge middle-man is gone since the direct-connection
# restructure).
#
# 10 rather than the obvious 1 because this build host is shared: another
# project's Autoware occupies domains 1-3, and a DDS domain is a shared
# namespace — two Autoware stacks on one domain fight over participant indices
# and each other's topics. Symptom when that happens: no participant can be
# created on the domain at all ("rmw handle is invalid" for every host node,
# the sim half-starting with 0/13 containers), which reads as a bug in whatever
# you changed last. Keep this in step with the justfile's ROS_DOMAIN_ID default
# and with `domain_id` in the bringup's system.toml ([system] and
# [image.native_sim]): the island bakes its domain
# at compile time and cannot pick it up from the environment.
#
# CONFIG_NROS_DOMAIN_ID is stated too (phase8-W14). nano-ros issue 1550's
# configure check compares system.toml's `domain_id` against
# CONFIG_NROS_DOMAIN_ID, not the Cyclone knob, and with only the line below it
# refused this image ("CONFIG_NROS_DOMAIN_ID = 0 ... system.toml domain_id =
# 10"). The Cyclone knob defaults to CONFIG_NROS_DOMAIN_ID; it stays stated
# so the DDS domain is visible here.
CONFIG_NROS_DOMAIN_ID=10
CONFIG_NROS_CYCLONE_DOMAIN_ID=10
# 4 ported nodes ≈ 30+ DDS entities, each with mutex+cond — the example
# default (256) exhausted mid-boot (ddsrt_mutex_init abort in the LAST
# node's ctor; the documented MAX_PTHREAD_MUTEX_COUNT pitfall, scaled).
#
# 16384 was in turn exhausted by the FULL Autoware graph: cyclone took one
# pool mutex per proxy entity AND one per addrset, so the count scaled with the
# remote endpoint count, not with our own. It hit exactly 16384/16384 ~19 s
# into SEDP ingestion and the next ddsrt_mutex_init silently failed — nano-ros
# issue 0371, which needed 131072 slots (~4.1 MiB of static RAM) to clear.
#
# ...and then the whole term went away. Cyclone's ddsrt now uses a Zephyr-NATIVE
# sync backend (issue 0496): ddsrt_mutex_t is an embedded `struct k_mutex` and
# ddsrt_cond_t an embedded `struct k_condvar`, so neither takes a slot from
# Zephyr's fixed pthread pools at all. The pool no longer scales with anything
# cyclone does, which is why these are back to the example defaults after having
# been walked up 256 -> 16384 -> 131072 chasing the graph size.
#
# They are not zero because Zephyr's POSIX layer is still used for THREADS
# (cyclone calls pthread_create) and for the single rwlock in ddsrt/src/log.c,
# neither of which scales with the graph.
CONFIG_MAX_PTHREAD_MUTEX_COUNT=256
CONFIG_MAX_PTHREAD_COND_COUNT=256

# Compile-time cyclone config (nano-ros issue 0367 wired the knob; env
# CYCLONEDDS_URI is invisible to native_sim). Direct-connection profile:
# multicast OFF (NSOS breaks cyclone's multicast waitset — phase 180) +
# unicast 127.0.0.1 peer scan WIDENED to 250 indices so the island can
# discover every participant of the Autoware stack on the demo domain (cyclone's
# default range of 9/baked 20 overflows on ~40 processes; overflowed
# participants take random ports and stay invisible to unicast scan
# forever). Sizing/Threads carried over from the nano-ros baked profile.
# Single-quoted XML attributes — Kconfig strings can't escape doubles.
CONFIG_NROS_CYCLONE_CONFIG_XML="<CycloneDDS><Domain Id='any'><General><AllowMulticast>false</AllowMulticast></General><Discovery><ParticipantIndex>auto</ParticipantIndex><MaxAutoParticipantIndex>120</MaxAutoParticipantIndex><Peers><Peer Address='127.0.0.1'/></Peers></Discovery><Sizing><ReceiveBufferSize>64 KiB</ReceiveBufferSize><ReceiveBufferChunkSize>16 KiB</ReceiveBufferChunkSize></Sizing><Threads><Thread Name='dq.builtins'><StackSize>64 KiB</StackSize></Thread></Threads><Tracing><Verbosity>warning</Verbosity><OutputFile>stdout</OutputFile></Tracing></Domain></CycloneDDS>"
CONFIG_THREAD_NAME=y
CONFIG_THREAD_MAX_NAME_LEN=32
```

## trace-window.conf
```kconfig
# phase8-W17: the native_sim island with the board's TRACE WINDOW (docs/tracing.md
# section 8). An extra conf fragment over prj.conf, not a default: the phase-7
# trace check (`just trace-native`) wants every marker from boot, which the window does not
# keep. Build with `just trace-window-native-build` (build-zephyr-window).
#
# The buffer stays prj.conf's 64 MiB: this line's native_sim board emits
# isr/idle events unconditionally and TRACING_THREAD is on, so the stream is
# not the board's. What this image verifies is the island's own half: the
# ring, the trigger, the record policy, and the island's record rate after the
# trigger, which `island_trace.py check` converts to the board's bytes.
CONFIG_ISLAND_TRACE_WINDOW=y
CONFIG_ISLAND_TRACE_PRE_MS=1500
CONFIG_ISLAND_TRACE_PRE_BYTES=2048
CONFIG_ISLAND_TRACE_SPIN_KEEP=10
```

## src/sim_clock_catch_up.c
```c
/*
 * The native_sim clock catch-up before the first spin (phase8-W29).
 *
 * WHAT IT FIXES. On native_sim the island heard its first availability
 * sample at 0.202 s of simulated time and the next at 0.82 s: a 520-630 ms
 * gap in every traced run (w8a-e, w14-e, w27-a/b/e), past the island's 500 ms
 * silence bound, and one tick of false MRM right after start-up. The gap is
 * not on the wire. Run w29-base-a, with the island's console stamped on the
 * host (tools/board/stamp.py):
 *
 *     host ms   island line
 *        45.7   [00:00:00.000,002] dds_create_participant returned
 *       729.2   [00:00:00.202,261] ... claimed at first spin
 *       730.5   [mrm_handler] INIT -> RUN
 *       759.8   [00:00:00.712,000] silence-runtime .../operation_mode_availability
 *       791.1   [mrm_handler] MRM State changed: NORMAL -> MRM_OPERATING
 *
 * 510 ms of simulated time between the last two nros lines took 30 ms of host
 * time. The gate published every 100 ms throughout (its stats: largest publish
 * gap 101.7 ms), and the host probe heard it every 100 ms.
 *
 * WHY. native_sim's simulated clock does not advance while embedded code
 * computes or blocks in a host call; it advances only when the CPU idles, and
 * in real-time mode it then runs as fast as it can until it is level with the
 * host again (scripts/native_simulator/native/src/timer_model.c,
 * hwtimer_tick_timer_reached: it sleeps only when AHEAD of the host). Joining
 * a running Autoware graph costs the island's boot 500-650 ms of host time --
 * participant creation, Cyclone ingesting the graph's discovery, the
 * components' registration -- at simulated time 0 to 0.2 s. The executor's
 * first spin therefore ran 530 ms behind the host, took the latest sample, and
 * then watched its clock sprint through half a second of simulated time in
 * about 40 ms of host time, during which, of course, nothing arrived. The
 * island's timers, and its 500 ms availability bound, run on that clock.
 * A board has no such clock: its boot costs the same work, but in real time,
 * before its first spin (rtss-work-2026-demo:experiments/serial-interop/w10: each 10 Hz input
 * taken 20-21 times in the first 2 s after a cold reset).
 *
 * THE FIX. The first call into the executor waits, in simulated time, until the
 * simulated clock is level with the host (to within CATCH_UP_SLACK_US), so the
 * sprint happens before the island takes or times anything, not after its
 * first sample. The wait is k_sleep(): an idle CPU is exactly what lets the
 * clock catch up. It is bounded (CATCH_UP_MAX_MS of simulated time) so a host
 * that cannot keep up cannot hold the island forever.
 *
 * HOW IT IS HOOKED. nano-ros's ZephyrBoard::run_components has no hook between
 * the components' setup and the spin loop (only nros_board_network_wait, which
 * runs before the session exists, and so before most of the stall). The link
 * wraps nros_cpp_spin_once (CMakeLists.txt: --wrap), the executor's single
 * entry point, so the first spin -- the spin loop's, or a blocking wait inside
 * a component's setup, whichever comes first -- goes through here. This file
 * is in the native_sim entry only; the board image is built from
 * src/zephyr_entry and never sees it.
 */
#include <zephyr/kernel.h>
#include <zephyr/sys/printk.h>

#include <stdbool.h>
#include <stdint.h>

/* native_sim's RTC (boards/native/native_sim, native_rtc.h): the simulated
 * clock, and the host's own clock seen through the same offset. */
#define RTC_CLOCK_REALTIME 1
#define RTC_CLOCK_PSEUDOHOSTREALTIME 2
extern uint64_t native_rtc_gettime_us(int clock_type);

#define CATCH_UP_SLACK_US 2000
#define CATCH_UP_MAX_MS 10000

int __real_nros_cpp_spin_once(void *handle, int32_t timeout_ms);

static int64_t lag_us(void)
{
	return (int64_t)native_rtc_gettime_us(RTC_CLOCK_PSEUDOHOSTREALTIME) -
	       (int64_t)native_rtc_gettime_us(RTC_CLOCK_REALTIME);
}

static void catch_up(void)
{
	const int64_t lag0 = lag_us();
	const int64_t t0 = k_uptime_get();
	int64_t lag = lag0;

	while (lag > CATCH_UP_SLACK_US && k_uptime_get() - t0 < CATCH_UP_MAX_MS) {
		k_sleep(K_USEC(lag < 50000 ? lag : 50000));
		lag = lag_us();
	}
	printk("[native_sim] first spin at %lld ms: the clock was %lld ms behind the host "
	       "(boot work at simulated time 0), held %lld ms to catch up, %lld ms behind now\n",
	       (long long)t0, (long long)(lag0 / 1000), (long long)(k_uptime_get() - t0),
	       (long long)(lag / 1000));
}

int __wrap_nros_cpp_spin_once(void *handle, int32_t timeout_ms)
{
	static bool caught_up;

	if (!caught_up) {
		caught_up = true;
		catch_up();
	}
	return __real_nros_cpp_spin_once(handle, timeout_ms);
}
```
